## board/itcr/taller/Kconfig
```kconfig
if TARGET_TALLER

config CPU_ARM810
	default y

config SYS_BOARD
	default "taller"

config SYS_VENDOR
	default "itcr"

config SYS_SOC
	default "ce3201"

config SYS_CONFIG_NAME
	default "taller"

endif
```

## configs/taller_defconfig
```kconfig
CONFIG_ARM=y
CONFIG_SKIP_LOWLEVEL_INIT_ONLY=y
CONFIG_TARGET_TALLER=y
CONFIG_SYS_TEXT_BASE=0x00000000
CONFIG_SYS_MALLOC_LEN=0x20000
CONFIG_SYS_MALLOC_F_LEN=0x400
CONFIG_NR_DRAM_BANKS=1
CONFIG_DM_GPIO=y
CONFIG_DEFAULT_DEVICE_TREE="taller"
CONFIG_SYS_LOAD_ADDR=0x00100000
CONFIG_FIT=y
CONFIG_SYS_CONSOLE_INFO_QUIET=y
CONFIG_DISPLAY_BOARDINFO_LATE=y
CONFIG_HUSH_PARSER=y
CONFIG_CMD_CLK=y
CONFIG_CMD_DM=y
CONFIG_CMD_GPIO=y
# CONFIG_CMD_NET is not set
CONFIG_CMD_CLS=y
CONFIG_OF_CONTROL=y
CONFIG_VERSION_VARIABLE=y
CONFIG_CLK=y
CONFIG_ALTERA_PIO=y
# CONFIG_MMC is not set
CONFIG_DM_SERIAL=y
CONFIG_ALTERA_JTAG_UART=y
CONFIG_ALTERA_JTAG_UART_BYPASS=y
CONFIG_TIMER=y
CONFIG_ALTERA_TIMER=y
CONFIG_DM_VIDEO=y
CONFIG_SYS_WHITE_ON_BLACK=y
CONFIG_VIDEO_SIMPLE=y
```
